## build/Kconfig/arch/Kconfig.tmp
```kconfig
# Load Zephyr Arch Kconfig descriptions.
osource "/home/not_cn_nguyen/CodeFile/PEROVSAT/perovsat-workspace/zephyr/arch/rx/Kconfig"
osource "/home/not_cn_nguyen/CodeFile/PEROVSAT/perovsat-workspace/zephyr/arch/x86/Kconfig"
osource "/home/not_cn_nguyen/CodeFile/PEROVSAT/perovsat-workspace/zephyr/arch/xtensa/Kconfig"
osource "/home/not_cn_nguyen/CodeFile/PEROVSAT/perovsat-workspace/zephyr/arch/sparc/Kconfig"
osource "/home/not_cn_nguyen/CodeFile/PEROVSAT/perovsat-workspace/zephyr/arch/riscv/Kconfig"
osource "/home/not_cn_nguyen/CodeFile/PEROVSAT/perovsat-workspace/zephyr/arch/posix/Kconfig"
osource "/home/not_cn_nguyen/CodeFile/PEROVSAT/perovsat-workspace/zephyr/arch/openrisc/Kconfig"
osource "/home/not_cn_nguyen/CodeFile/PEROVSAT/perovsat-workspace/zephyr/arch/mips/Kconfig"
osource "/home/not_cn_nguyen/CodeFile/PEROVSAT/perovsat-workspace/zephyr/arch/arm64/Kconfig"
osource "/home/not_cn_nguyen/CodeFile/PEROVSAT/perovsat-workspace/zephyr/arch/arm/Kconfig"
osource "/home/not_cn_nguyen/CodeFile/PEROVSAT/perovsat-workspace/zephyr/arch/arc/Kconfig"
```

## build/Kconfig/boards/Kconfig.defconfig
```kconfig
# Load Zephyr board defconfig descriptions.
osource "/home/not_cn_nguyen/CodeFile/PEROVSAT/perovsat-workspace/zephyr/boards/raspberrypi/rpi_pico2/Kconfig.defconfig"
```

## build/Kconfig/boards/Kconfig.rpi_pico2.tmp
```kconfig
# Load board Kconfig descriptions.
osource "/home/not_cn_nguyen/CodeFile/PEROVSAT/perovsat-workspace/zephyr/boards/raspberrypi/rpi_pico2/Kconfig.rpi_pico2"
```

## build/Kconfig/soc/Kconfig
```kconfig
# Load Zephyr SoC Kconfig descriptions.
osource "/home/not_cn_nguyen/CodeFile/PEROVSAT/perovsat-workspace/zephyr/soc/xlnx/zynqmp/Kconfig"
osource "/home/not_cn_nguyen/CodeFile/PEROVSAT/perovsat-workspace/zephyr/soc/xlnx/zynq7000/Kconfig"
osource "/home/not_cn_nguyen/CodeFile/PEROVSAT/perovsat-workspace/zephyr/soc/xlnx/versalnet/Kconfig"
osource "/home/not_cn_nguyen/CodeFile/PEROVSAT/perovsat-workspace/zephyr/soc/xlnx/versal2/Kconfig"
osource "/home/not_cn_nguyen/CodeFile/PEROVSAT/perovsat-workspace/zephyr/soc/xlnx/versal/Kconfig"
osource "/home/not_cn_nguyen/CodeFile/PEROVSAT/perovsat-workspace/zephyr/soc/xen/Kconfig"
osource "/home/not_cn_nguyen/CodeFile/PEROVSAT/perovsat-workspace/zephyr/soc/wch/ch32v/Kconfig"
osource "/home/not_cn_nguyen/CodeFile/PEROVSAT/perovsat-workspace/zephyr/soc/ti/simplelink/Kconfig"
osource "/home/not_cn_nguyen/CodeFile/PEROVSAT/perovsat-workspace/zephyr/soc/ti/mspm0/Kconfig"
osource "/home/not_cn_nguyen/CodeFile/PEROVSAT/perovsat-workspace/zephyr/soc/ti/lm3s6965/Kconfig"
osource "/home/not_cn_nguyen/CodeFile/PEROVSAT/perovsat-workspace/zephyr/soc/ti/k3/Kconfig"
osource "/home/not_cn_nguyen/CodeFile/PEROVSAT/perovsat-workspace/zephyr/soc/telink/tlsr/Kconfig"
osource "/home/not_cn_nguyen/CodeFile/PEROVSAT/perovsat-workspace/zephyr/soc/syna/sr100/Kconfig"
osource "/home/not_cn_nguyen/CodeFile/PEROVSAT/perovsat-workspace/zephyr/soc/starfive/jh71xx/Kconfig"
osource "/home/not_cn_nguyen/CodeFile/PEROVSAT/perovsat-workspace/zephyr/soc/st/stm32/Kconfig"
osource "/home/not_cn_nguyen/CodeFile/PEROVSAT/perovsat-workspace/zephyr/soc/snps/qemu_arc/Kconfig"
osource "/home/not_cn_nguyen/CodeFile/PEROVSAT/perovsat-workspace/zephyr/soc/snps/nsim/arc_v/Kconfig"
osource "/home/not_cn_nguyen/CodeFile/PEROVSAT/perovsat-workspace/zephyr/soc/snps/nsim/arc_classic/Kconfig"
osource "/home/not_cn_nguyen/CodeFile/PEROVSAT/perovsat-workspace/zephyr/soc/snps/hsdk4xd/Kconfig"
osource "/home/not_cn_nguyen/CodeFile/PEROVSAT/perovsat-workspace/zephyr/soc/snps/hsdk/Kconfig"
osource "/home/not_cn_nguyen/CodeFile/PEROVSAT/perovsat-workspace/zephyr/soc/snps/emsk/Kconfig"
osource "/home/not_cn_nguyen/CodeFile/PEROVSAT/perovsat-workspace/zephyr/soc/snps/emsdp/Kconfig"
osource "/home/not_cn_nguyen/CodeFile/PEROVSAT/perovsat-workspace/zephyr/soc/snps/arc_iot/Kconfig"
osource "/home/not_cn_nguyen/CodeFile/PEROVSAT/perovsat-workspace/zephyr/soc/silabs/Kconfig"
osource "/home/not_cn_nguyen/CodeFile/PEROVSAT/perovsat-workspace/zephyr/soc/sifli/sf32/Kconfig"
osource "/home/not_cn_nguyen/CodeFile/PEROVSAT/perovsat-workspace/zephyr/soc/sifive/sifive_freedom/Kconfig"
osource "/home/not_cn_nguyen/CodeFile/PEROVSAT/perovsat-workspace/zephyr/soc/sensry/Kconfig"
osource "/home/not_cn_nguyen/CodeFile/PEROVSAT/perovsat-workspace/zephyr/soc/rockchip/Kconfig"
osource "/home/not_cn_nguyen/CodeFile/PEROVSAT/perovsat-workspace/zephyr/soc/renode/riscv_virtual/Kconfig"
osource "/home/not_cn_nguyen/CodeFile/PEROVSAT/perovsat-workspace/zephyr/soc/renode/cortex_r8_virtual/Kconfig"
osource "/home/not_cn_nguyen/CodeFile/PEROVSAT/perovsat-workspace/zephyr/soc/renesas/smartbond/Kconfig"
osource "/home/not_cn_nguyen/CodeFile/PEROVSAT/perovsat-workspace/zephyr/soc/renesas/rz/Kconfig"
osource "/home/not_cn_nguyen/CodeFile/PEROVSAT/perovsat-workspace/zephyr/soc/renesas/rx/Kconfig"
osource "/home/not_cn_nguyen/CodeFile/PEROVSAT/perovsat-workspace/zephyr/soc/renesas/rcar/Kconfig"
osource "/home/not_cn_nguyen/CodeFile/PEROVSAT/perovsat-workspace/zephyr/soc/renesas/ra/Kconfig"
osource "/home/not_cn_nguyen/CodeFile/PEROVSAT/perovsat-workspace/zephyr/soc/realtek/fingerprint/Kconfig"
osource "/home/not_cn_nguyen/CodeFile/PEROVSAT/perovsat-workspace/zephyr/soc/realtek/ec/Kconfig"
osource "/home/not_cn_nguyen/CodeFile/PEROVSAT/perovsat-workspace/zephyr/soc/realtek/bee/Kconfig"
osource "/home/not_cn_nguyen/CodeFile/PEROVSAT/perovsat-workspace/zephyr/soc/realtek/ameba/Kconfig"
osource "/home/not_cn_nguyen/CodeFile/PEROVSAT/perovsat-workspace/zephyr/soc/raspberrypi/rpi_pico/Kconfig"
osource "/home/not_cn_nguyen/CodeFile/PEROVSAT/perovsat-workspace/zephyr/soc/quicklogic/eos_s3/Kconfig"
osource "/home/not_cn_nguyen/CodeFile/PEROVSAT/perovsat-workspace/zephyr/soc/qemu/virt_riscv/Kconfig"
osource "/home/not_cn_nguyen/CodeFile/PEROVSAT/perovsat-workspace/zephyr/soc/qemu/or1k/Kconfig"
osource "/home/not_cn_nguyen/CodeFile/PEROVSAT/perovsat-workspace/zephyr/soc/qemu/malta/Kconfig"
osource "/home/not_cn_nguyen/CodeFile/PEROVSAT/perovsat-workspace/zephyr/soc/openisa/rv32m1/Kconfig"
osource "/home/not_cn_nguyen/CodeFile/PEROVSAT/perovsat-workspace/zephyr/soc/openhwgroup/cva6/Kconfig"
osource "/home/not_cn_nguyen/CodeFile/PEROVSAT/perovsat-workspace/zephyr/soc/oct/osd32mp15x/Kconfig"
osource "/home/not_cn_nguyen/CodeFile/PEROVSAT/perovsat-workspace/zephyr/soc/nxp/s32/Kconfig"
osource "/home/not_cn_nguyen/CodeFile/PEROVSAT/perovsat-workspace/zephyr/soc/nxp/rw/Kconfig"
osource "/home/not_cn_nguyen/CodeFile/PEROVSAT/perovsat-workspace/zephyr/soc/nxp/mcx/Kconfig"
osource "/home/not_cn_nguyen/CodeFile/PEROVSAT/perovsat-workspace/zephyr/soc/nxp/lpc/Kconfig"
osource "/home/not_cn_nguyen/CodeFile/PEROVSAT/perovsat-workspace/zephyr/soc/nxp/layerscape/Kconfig"
osource "/home/not_cn_nguyen/CodeFile/PEROVSAT/perovsat-workspace/zephyr/soc/nxp/kinetis/Kconfig"
osource "/home/not_cn_nguyen/CodeFile/PEROVSAT/perovsat-workspace/zephyr/soc/nxp/imxrt/Kconfig"
osource "/home/not_cn_nguyen/CodeFile/PEROVSAT/perovsat-workspace/zephyr/soc/nxp/imx/Kconfig"
osource "/home/not_cn_nguyen/CodeFile/PEROVSAT/perovsat-workspace/zephyr/soc/nuvoton/numicro/Kconfig"
osource "/home/not_cn_nguyen/CodeFile/PEROVSAT/perovsat-workspace/zephyr/soc/nuvoton/numaker/Kconfig"
osource "/home/not_cn_nguyen/CodeFile/PEROVSAT/perovsat-workspace/zephyr/soc/nuvoton/npcx/Kconfig"
osource "/home/not_cn_nguyen/CodeFile/PEROVSAT/perovsat-workspace/zephyr/soc/nuvoton/npcm/Kconfig"
osource "/home/not_cn_nguyen/CodeFile/PEROVSAT/perovsat-workspace/zephyr/soc/nordic/Kconfig"
osource "/home/not_cn_nguyen/CodeFile/PEROVSAT/perovsat-workspace/zephyr/soc/neorv32/Kconfig"
osource "/home/not_cn_nguyen/CodeFile/PEROVSAT/perovsat-workspace/zephyr/soc/native/inf_clock/Kconfig"
osource "/home/not_cn_nguyen/CodeFile/PEROVSAT/perovsat-workspace/zephyr/soc/microchip/sam/sama7/Kconfig"
osource "/home/not_cn_nguyen/CodeFile/PEROVSAT/perovsat-workspace/zephyr/soc/microchip/sam/sam_d5x_e5x/Kconfig"
osource "/home/not_cn_nguyen/CodeFile/PEROVSAT/perovsat-workspace/zephyr/soc/microchip/pic64/Kconfig"
osource "/home/not_cn_nguyen/CodeFile/PEROVSAT/perovsat-workspace/zephyr/soc/microchip/pic32c/pic32cz_ca/Kconfig"
osource "/home/not_cn_nguyen/CodeFile/PEROVSAT/perovsat-workspace/zephyr/soc/microchip/pic32c/pic32cx_sg/Kconfig"
osource "/home/not_cn_nguyen/CodeFile/PEROVSAT/perovsat-workspace/zephyr/soc/microchip/pic32c/pic32cm_pl/Kconfig"
osource "/home/not_cn_nguyen/CodeFile/PEROVSAT/perovsat-workspace/zephyr/soc/microchip/pic32c/pic32cm_jh/Kconfig"
osource "/home/not_cn_nguyen/CodeFile/PEROVSAT/perovsat-workspace/zephyr/soc/microchip/miv/Kconfig"
osource "/home/not_cn_nguyen/CodeFile/PEROVSAT/perovsat-workspace/zephyr/soc/microchip/mec/Kconfig"
osource "/home/not_cn_nguyen/CodeFile/PEROVSAT/perovsat-workspace/zephyr/soc/mediatek/mt8xxx/Kconfig"
osource "/home/not_cn_nguyen/CodeFile/PEROVSAT/perovsat-workspace/zephyr/soc/lowrisc/opentitan/Kconfig"
osource "/home/not_cn_nguyen/CodeFile/PEROVSAT/perovsat-workspace/zephyr/soc/litex/litex_vexriscv/Kconfig"
osource "/home/not_cn_nguyen/CodeFile/PEROVSAT/perovsat-workspace/zephyr/soc/ite/ec/Kconfig"
osource "/home/not_cn_nguyen/CodeFile/PEROVSAT/perovsat-workspace/zephyr/soc/intel/wildcat_lake/Kconfig"
osource "/home/not_cn_nguyen/CodeFile/PEROVSAT/perovsat-workspace/zephyr/soc/intel/raptor_lake/Kconfig"
osource "/home/not_cn_nguyen/CodeFile/PEROVSAT/perovsat-workspace/zephyr/soc/intel/panther_lake/Kconfig"
osource "/home/not_cn_nguyen/CodeFile/PEROVSAT/perovsat-workspace/zephyr/soc/intel/lakemont/Kconfig"
osource "/home/not_cn_nguyen/CodeFile/PEROVSAT/perovsat-workspace/zephyr/soc/intel/intel_socfpga_std/Kconfig"
osource "/home/not_cn_nguyen/CodeFile/PEROVSAT/perovsat-workspace/zephyr/soc/intel/intel_socfpga/Kconfig"
osource "/home/not_cn_nguyen/CodeFile/PEROVSAT/perovsat-workspace/zephyr/soc/intel/intel_niosv/Kconfig"
osource "/home/not_cn_nguyen/CodeFile/PEROVSAT/perovsat-workspace/zephyr/soc/intel/intel_ish/Kconfig"
osource "/home/not_cn_nguyen/CodeFile/PEROVSAT/perovsat-workspace/zephyr/soc/intel/intel_adsp/Kconfig"
osource "/home/not_cn_nguyen/CodeFile/PEROVSAT/perovsat-workspace/zephyr/soc/intel/elkhart_lake/Kconfig"
osource "/home/not_cn_nguyen/CodeFile/PEROVSAT/perovsat-workspace/zephyr/soc/intel/atom/Kconfig"
osource "/home/not_cn_nguyen/CodeFile/PEROVSAT/perovsat-workspace/zephyr/soc/intel/apollo_lake/Kconfig"
osource "/home/not_cn_nguyen/CodeFile/PEROVSAT/perovsat-workspace/zephyr/soc/intel/alder_lake/Kconfig"
osource "/home/not_cn_nguyen/CodeFile/PEROVSAT/perovsat-workspace/zephyr/soc/infineon/psoc4/Kconfig"
osource "/home/not_cn_nguyen/CodeFile/PEROVSAT/perovsat-workspace/zephyr/soc/infineon/edge/Kconfig"
osource "/home/not_cn_nguyen/CodeFile/PEROVSAT/perovsat-workspace/zephyr/soc/infineon/cat3/Kconfig"
osource "/home/not_cn_nguyen/CodeFile/PEROVSAT/perovsat-workspace/zephyr/soc/infineon/cat1c/Kconfig"
osource "/home/not_cn_nguyen/CodeFile/PEROVSAT/perovsat-workspace/zephyr/soc/infineon/cat1b/Kconfig"
osource "/home/not_cn_nguyen/CodeFile/PEROVSAT/perovsat-workspace/zephyr/soc/infineon/cat1a/Kconfig"
osource "/home/not_cn_nguyen/CodeFile/PEROVSAT/perovsat-workspace/zephyr/soc/gd/gd32/Kconfig"
osource "/home/not_cn_nguyen/CodeFile/PEROVSAT/perovsat-workspace/zephyr/soc/gaisler/leon3/Kconfig"
osource "/home/not_cn_nguyen/CodeFile/PEROVSAT/perovsat-workspace/zephyr/soc/gaisler/gr716a/Kconfig"
osource "/home/not_cn_nguyen/CodeFile/PEROVSAT/perovsat-workspace/zephyr/soc/focaltech/Kconfig"
osource "/home/not_cn_nguyen/CodeFile/PEROVSAT/perovsat-workspace/zephyr/soc/espressif/Kconfig"
osource "/home/not_cn_nguyen/CodeFile/PEROVSAT/perovsat-workspace/zephyr/soc/ene/kb1200/Kconfig"
osource "/home/not_cn_nguyen/CodeFile/PEROVSAT/perovsat-workspace/zephyr/soc/ene/kb106x/Kconfig"
osource "/home/not_cn_nguyen/CodeFile/PEROVSAT/perovsat-workspace/zephyr/soc/elan/em32f967/Kconfig"
osource "/home/not_cn_nguyen/CodeFile/PEROVSAT/perovsat-workspace/zephyr/soc/egis/Kconfig"
osource "/home/not_cn_nguyen/CodeFile/PEROVSAT/perovsat-workspace/zephyr/soc/efinix/sapphire/Kconfig"
osource "/home/not_cn_nguyen/CodeFile/PEROVSAT/perovsat-workspace/zephyr/soc/cdns/xtensa_sample_controller/Kconfig"
osource "/home/not_cn_nguyen/CodeFile/PEROVSAT/perovsat-workspace/zephyr/soc/cdns/swerv/Kconfig"
osource "/home/not_cn_nguyen/CodeFile/PEROVSAT/perovsat-workspace/zephyr/soc/cdns/sample_controller32/Kconfig"
osource "/home/not_cn_nguyen/CodeFile/PEROVSAT/perovsat-workspace/zephyr/soc/cdns/dc233c/Kconfig"
osource "/home/not_cn_nguyen/CodeFile/PEROVSAT/perovsat-workspace/zephyr/soc/brcm/bcmvk/Kconfig"
osource "/home/not_cn_nguyen/CodeFile/PEROVSAT/perovsat-workspace/zephyr/soc/brcm/bcm2712/Kconfig"
osource "/home/not_cn_nguyen/CodeFile/PEROVSAT/perovsat-workspace/zephyr/soc/brcm/bcm2711/Kconfig"
osource "/home/not_cn_nguyen/CodeFile/PEROVSAT/perovsat-workspace/zephyr/soc/blackberry/qnxhv_vm/Kconfig"
osource "/home/not_cn_nguyen/CodeFile/PEROVSAT/perovsat-workspace/zephyr/soc/bflb/Kconfig"
osource "/home/not_cn_nguyen/CodeFile/PEROVSAT/perovsat-workspace/zephyr/soc/atmel/sam0/Kconfig"
osource "/home/not_cn_nguyen/CodeFile/PEROVSAT/perovsat-workspace/zephyr/soc/atmel/sam/Kconfig"
osource "/home/not_cn_nguyen/CodeFile/PEROVSAT/perovsat-workspace/zephyr/soc/aspeed/Kconfig"
osource "/home/not_cn_nguyen/CodeFile/PEROVSAT/perovsat-workspace/zephyr/soc/arm/Kconfig"
osource "/home/not_cn_nguyen/CodeFile/PEROVSAT/perovsat-workspace/zephyr/soc/arm/beetle/Kconfig"
osource "/home/not_cn_nguyen/CodeFile/PEROVSAT/perovsat-workspace/zephyr/soc/antmicro/myra/Kconfig"
osource "/home/not_cn_nguyen/CodeFile/PEROVSAT/perovsat-workspace/zephyr/soc/andestech/Kconfig"
osource "/home/not_cn_nguyen/CodeFile/PEROVSAT/perovsat-workspace/zephyr/soc/amd/acp_6_0/Kconfig"
osource "/home/not_cn_nguyen/CodeFile/PEROVSAT/perovsat-workspace/zephyr/soc/ambiq/Kconfig"
osource "/home/not_cn_nguyen/CodeFile/PEROVSAT/perovsat-workspace/zephyr/soc/allwinner/sun8i_h3/Kconfig"
osource "/home/not_cn_nguyen/CodeFile/PEROVSAT/perovsat-workspace/zephyr/soc/alif/ensemble/Kconfig"
osource "/home/not_cn_nguyen/CodeFile/PEROVSAT/perovsat-workspace/zephyr/soc/aesc/Kconfig"
osource "/home/not_cn_nguyen/CodeFile/PEROVSAT/perovsat-workspace/zephyr/soc/adi/max32/Kconfig"
```

## src/Kconfig
```kconfig
config PEROVSAT_EYESTAR
	bool "EYESTAR driver"
	depends on DT_HAS_NEARSPACELAUNCH_EYESTAR_ENABLED
	help
	  Enable the EYESTAR Zephyr driver module.

if PEROVSAT_EYESTAR

choice
	prompt "EYESTAR backend"
	default PEROVSAT_EYESTAR_BACKEND_PUBLIC_MOCK

config PEROVSAT_EYESTAR_BACKEND_HARDWARE
	bool "Hardware (real device over bus)"
	help
	  Link lib/eyestar.c with src/hardware_transfer.c.
	  Fill in that file when bringing the chip up.
	  FILL IN: add "select I2C" (or SPI / SERIAL) on this symbol to match
	  the part.

config PEROVSAT_EYESTAR_BACKEND_LIBRARY_MOCK
	bool "Library mock (lib/ without hardware)"
	help
	  Link lib/eyestar.c with src/lib_mock_transfer.c.

config PEROVSAT_EYESTAR_BACKEND_PUBLIC_MOCK
	bool "Public mock (hardcoded data, no library required)"
	help
	  Link mock/eyestar.c instead of lib/eyestar.c.
	  Safe for CI and repos without NDA library access.

endchoice

endif
```
