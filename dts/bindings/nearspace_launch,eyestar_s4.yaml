## dts/bindings/nearspace_launch,eyestar_s4.yaml
```yaml
description: EYESTAR_S4 device driver

compatible: "nearspace_launch,eyestar_s4"

include: base.yaml

# properties:
  # FILL IN: devicetree properties (mirror struct eyestar_s4_config fields)
```
